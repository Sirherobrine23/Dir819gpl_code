## DIR819_v1.05/src/kernel/linux-2.6.36.x/drivers/button/Kconfig
```kconfig
menu "Button drivers"

config TBS_BUTTON
	bool "TBS Button Support"
	default y
	help
	  Say Y to enable TBS Button driver framwork.This allows monitor of supported
	  buttons.


comment "Button device"


config BUTTON_AR7130
	tristate "Button support for the AR7130"
	depends on TBS_BUTTON && MACH_AR7100
	help
	  This option enables support for the buttons on AR7130.


config BUTTON_AMAZON_SE
	tristate "Button support for the Amazon-SE"
	depends on TBS_BUTTON && AMAZON_SE
	help
	  This option enables support for the buttons on Infineon Amazon-SE.

config BUTTON_RT3052
	tristate "Button support for the RT3052"
	depends on TBS_BUTTON && RALINK_RT3052
	help
	  This option enables support for the buttons on Ralink rt3052.

config BUTTON_MT7620A
	tristate "Button support for the MT7620A"
	depends on TBS_BUTTON && RALINK_MT7620A
	help
	  This option enables support for the buttons on Ralink MT7620A.
	  
config BUTTON_VX180
	tristate "Button support for the VX180"
	depends on TBS_BUTTON && FUSIV_VX180
	help
	  This option enables support for the buttons on IKANOS Vx180.

config BUTTON_RTL8672
	tristate "Button support for the RTL8672"
	depends on TBS_BUTTON && RTL8672
	help
	  This option enables support for the buttons on Realtek RTL8672.

config BUTTON_RTL8196C
	tristate "Button support for the RTL8196C"
	depends on TBS_BUTTON && RTL_8196C
	help
	  This option enables support for the buttons on Realtek RTL8196C.
	  
config BUTTON_C1000
	tristate "Button support for the C1000(poll mode)"
	depends on TBS_BUTTON && ARCH_M83XXX
	help
	  This option enables support for the buttons on Mindspeed C1000.

config BUTTON_C1000_INT
	tristate "Button support for the C1000(interrupt mode)"
	depends on TBS_BUTTON && ARCH_M83XXX
	help
	  This option enables support for the buttons on Mindspeed C1000.

comment "Button option"

config BUTTON_TRIGGER_TIMER
	tristate "Button trigger timer"
	depends on TBS_BUTTON
	help
	  This option enable button timer trigger function.
	  If button device use interrupt,say N.
	  If no interrupt, say Y.

endmenu
```

## DIR819_v1.06/src/apps/html/Config.in
```kconfig
######################################

config APPS_HTML
	bool 'HTML'
	default y
	depends on APPS
	select APPS_WEB
	#select APPS_HTML_PAGE_system_msg
  	help
      	  HTML Pages
######################################
menu "Languages"
	depends on APPS_HTML

	menu "All Supported Languages"
		depends on APPS_HTML

		config APPS_HTML_LANG_SUPPORT_en_us
			bool 'English'
			default n
			help
				Support English Language.

		config APPS_HTML_LANG_SUPPORT_zh_cn
			bool 'Chinse'
			default n
			help
				Support Chinse Language.
		config APPS_HTML_LANG_SUPPORT_pt
		        bool 'Portugal'
			default y
			help
				Support Portugal Language.

	endmenu

	choice
		prompt "Default language"
		default APPS_HTML_LANG_DEFAULT_pt
		depends on APPS_HTML

		config APPS_HTML_LANG_DEFAULT_en_us
			bool 'English'
			select APPS_HTML_LANG_SUPPORT_en_us
			help
				English as default language.

		config APPS_HTML_LANG_DEFAULT_zh_cn
			bool 'Chinese'
			select APPS_HTML_LANG_SUPPORT_zh_cn
			help
				Chinese as default language
		config APPS_HTML_LANG_DEFAULT_pt
		        bool 'Portugal'
			select APPS_HTML_LANG_SUPPORT_pt
			help
				Portugal as default language.
	endchoice



endmenu
######################################
menu "Web Style"
	depends on APPS_HTML
	choice
		prompt "All Supported Style"
		default APPS_HTML_WEB_STYLE_DLINK_AC750_PT
		depends on APPS_HTML

		config APPS_HTML_WEB_STYLE_DLINK_AC750
			bool 'dlink_AC750'
			help
				Web DLINK AC750 style			

		config APPS_HTML_WEB_STYLE_SITECOM
			bool 'Sitecom'
			help
				Web  Sitecom  style

		config APPS_HTML_WEB_STYLE_ACT
			bool 'ACT'
			help
				Web  ACT  style
		config APPS_HTML_WEB_STYLE_DLINK_AC750_PT
			bool ' dlink_AC750_PT'
			help
				Web   dlink_AC750_PT  style
		config APPS_HTML_WEB_STYLE_DLINK_AC750_EU
			bool ' dlink_AC750_EU'
			help
				Web   dlink_AC750_EU  style
	endchoice
	
	choice
		prompt "Default Style"
		default APPS_HTML_WEB_STYLE_DEFAULT_DLINK_AC750_PT
		depends on APPS_HTML

		config APPS_HTML_WEB_STYLE_DEFAULT_DLINK_AC750
			bool 'dlink_AC750'
			select APPS_HTML_WEB_STYLE_DLINK_AC750
			help
				Dlink AC750 as default style

		config APPS_HTML_WEB_STYLE_DEFAULT_SITECOM
			bool 'Sitecom'
			help
				Web  Sitecom  style
		
		config APPS_HTML_WEB_STYLE_DEFAULT_ACT
			bool 'ACT'
			help
				Web  ACT  style
		config APPS_HTML_WEB_STYLE_DEFAULT_DLINK_AC750_PT
			bool ' dlink_AC750_PT'
			help
				Web   dlink_AC750_PT  style
		config APPS_HTML_WEB_STYLE_DEFAULT_DLINK_AC750_EU
			bool ' dlink_AC750_EU'
			help
				Web   dlink_AC750_EU  style
	endchoice
	
	config APPS_HTML_WEB_LOGIN_WIZARD
			bool 'telefonica login wizard'
			default n
			help
				 telefonica's request when logging in the CPE ,  pop out a specific wizard page
				 
	
endmenu
```

## DIR819_v1.06/src/vendor/imgcrypt/Config.in
```kconfig
config VENDOR_IMGCRYPT
    bool 'IMGCRYPT'
    depends VENDOR
    default n 
    help
       For Dlink Firmware Encryption
```
